/*******************************************************************************  
* 文件名称：按键控制实验
* 实验目的：1.掌握单片机IO口操作的基本方法
*           2.掌握C51关键字"sbit"的用法
*           2.掌握单片机常见外围驱动电路的设计方法 
* 程序说明：使用程序前，将跳线J2调整为BTN模式
* 硬件环境：IAP15F2K61S2@11.0592MHz
* 日期版本：2012-9-3/V1.0a 
*******************************************************************************/

#include "reg52.h"  //定义51单片机特殊功能寄存器

/** 独立按键接口 */
sbit S7  = P3^0;
sbit S6  = P3^1;
sbit S5  = P3^2;
sbit S4  = P3^3;
sbit K=P3^7;
sbit buzz  = P0^6;

//
void cls_buzz(void)
{
	P2 = (P2&0x1F|0xA0);
	P0 = 0x00;
	P2 &= 0x1F;
}

//主函数
void main(void)
{    
	cls_buzz();
	K=0;
    while(1)
    {
        if(S7 == 0)
        {
            P2 = ((P2&0x1f)|0x80);
			P0 = 0xff;  //关闭所有LED
			P2 &= 0x1f;
        }
        if(S6 == 0)
        {
            P2 = ((P2&0x1f)|0x80);
            P0 = 0x00;  //打开所有LED
			P2 &= 0x1f;
        }
        if(S5 == 0)
        {
            P2 = ((P2&0x1f)|0xa0);
			P0 = 0x00;
			buzz = 1;	//打开蜂鸣器
			P2 &= 0x1f;
        }
        if(S4 == 0)
        {
            P2 = ((P2&0x1f)|0xa0);
			P0 = 0x00;
			buzz = 0;	//关闭蜂鸣器
			P2 &= 0x1f;
        }

    }
}