/**************************************************************************
实验功能：第三届省赛试题程序设计
时间：2017.12.21
作者：吴康
***************************************************************************/
#include <STC15F2K60S2.H>
#include <intrins.h>
#include <iic.h>

#define uchar unsigned char 
#define uint unsigned int	

uchar code tab[]={0XC0,0XF9,0XA4,0XB0,0X99,0X92,0X82,0XF8,0X80,0X90,0XFF};
uchar dsbuff[8]={11,0,5,0,0,0,0,0};
uchar tt=0;				//定时时间变量
uint ML=0;				//出水量存储变量
uint money=0;			//根据出水量计算出费用
uchar guan=0;			//采集的光敏电阻两端电压
uchar discount;		//数码管移位变量

/**************************************************************************
函数名称：delayms
功能：延时函数
***************************************************************************/
void delayms(int ms)
{
	int i,j;
	for(i=ms;i>0;i--)
		for(j=845;j>0;j--);
}

/**************************************************************************
函数名称：allinit
功能：板子整体初始化函数
***************************************************************************/
void allinit()
{
	P2=0XA0;
	P0=0X00;//关闭蜂鸣器，继电器
	
	P2=0X80;
	P0=0XFF;//关闭LED灯
	
	P2=0XC0;
	P0=0XFF;//选择所有数码管
	P2=0XFF;
	P0=0XFF;//关闭所有数码管
}

/**************************************************************************
函数名称：display
功能：显示函数
***************************************************************************/
void display()
{
	P2=0xef;
	P0=0xff;
	P2=0x1f;
	
  P2=0xcf;
	P0=1<<discount;
	P2=0x1f;
	
	P2=0xef;
	if(discount==5||discount==1)//要加小数点需要判断
	P0=tab[dsbuff[discount]]&0x7f;
	else P0=tab[dsbuff[discount]];
	P2=0x1f;
	
	if(++discount==8)
	 	discount = 0;
}

/**************************************************************************
函数名称：Timer0Init
功能：定时器0初始化函数
***************************************************************************/
void Timer0Init(void)		//5毫秒@11.0592MHz
{
	AUXR |= 0x80;					//定时器时钟1T模式
	TMOD &= 0xF0;					//设置定时器模式
	TL0 = 0x00;						//设置定时初值
	TH0 = 0x28;						//设置定时初值
	TF0 = 0;							//清除TF0标志
	TR0 = 1;							//定时器0开始计时
}

/**************************************************************************
函数名称：rel
功能：初始化函数
***************************************************************************/
void rel(uchar dong)
{
	if(dong==0)
	{
		P2=0XA0;P0=0X00;//全关
	}
	else if(dong==1)
	{
		P2=0XA0;P0=0X40;//开蜂鸣器 
	}
	else if(dong==2)
	{
		P2=0XA0;P0=0X10;//开继电器
	}
	else if(dong==3)
	{
		P2=0XA0;P0=0Xff;//全开
	}
}

/**************************************************************************
函数名称：keyscan
功能：按键扫描函数
***************************************************************************/
void keyscan()
{
	if(P30==0)			//打开定时器持续出水，当第二次按时先清零在开始出水
	{
		delayms(5);
		if(P30==0)
		{
			rel(2);			//打开继电器
			dsbuff[4]=0;
			dsbuff[5]=0;
			dsbuff[6]=0;
			dsbuff[7]=0;
			EA=1;
			ET0=1;
		}
		while(!P30);
	}
	else if(P31==0)		//关闭定时器计算出出水的价格（扩大了10倍）
	{
		delayms(5);
		if(P31==0)
		{
			EA=0;
			ET0=0;
			rel(0);				//关闭继电器
			money=ML*5;
			dsbuff[4]=money/100000;
			dsbuff[5]=money%100000/10000;
			dsbuff[6]=money%10000/1000;
			dsbuff[7]=money%1000/100;
			ML=0;	
		}
		while(!P31);
	}
}

/**************************************************************************
函数名称：adrun
功能：采集光敏电阻电压函数
***************************************************************************/
void adrun()
{
	uchar num;
	num=iicread(0x01);//采集光敏电阻所在通道电压
	if(num<25)				//小于1.25V点亮L1
	{
		P2=0X80;
		P0=0XFE;
	}
	else 							//大于1.25V关闭L1
	{
		P2=0X80;
		P0=0XFF;
	}
}

/**************************************************************************
函数名称：main
功能：主函数
***************************************************************************/
void main()
{
	allinit();			//板子整体初始化
	Timer0Init();		//定时器0初始化
	while(1)
	{
		adrun();			//采集光敏电阻电压
		keyscan();		//按键扫描函数
		display();		//数码管显示函数
		delayms(1);		//扫描时间1MS
	}
}

/**************************************************************************
函数名称：time0
功能：中断服务函数
***************************************************************************/
void time0() interrupt 1
{
	tt++;
	if(tt==20)
	{
		tt=0;
		ML=ML+10;
		dsbuff[4]=ML/10000;
		dsbuff[5]=ML%10000/1000;
		dsbuff[6]=ML%1000/100;
		dsbuff[7]=ML%100/10;
		if(ML>99990)
		{
			EA=0;
			ET0=0;
			rel(0);
			money=ML*5;
			dsbuff[4]=money/100000;
			dsbuff[5]=money%100000/10000;
			dsbuff[6]=money%10000/1000;
			dsbuff[7]=money%1000/100;
			ML=0;	
		}
	}
}
